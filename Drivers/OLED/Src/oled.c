#include "oled.h"

#include <string.h>

static const uint8_t oled_font6x8[][6] =
{
  {0x00, 0x00, 0x00, 0x00, 0x00, 0x00}, /* space */
  {0x7E, 0x11, 0x11, 0x11, 0x7E, 0x00}, /* A */
  {0x7F, 0x49, 0x49, 0x49, 0x36, 0x00}, /* B */
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  {0x44, 0x64, 0x54, 0x4C, 0x44, 0x00}  /* z */
};

static const uint8_t *OLED_GetFont6x8(char ch)
{
  if (ch == ' ')
  {
    return oled_font6x8[0];
  }

  if ((ch >= 'A') && (ch <= 'Z'))
  {
    return oled_font6x8[1 + (ch - 'A')];
  }

  if ((ch >= '0') && (ch <= '9'))
  {
    return oled_font6x8[27 + (ch - '0')];
  }

  if ((ch >= 'a') && (ch <= 'z'))
  {
    return oled_font6x8[37 + (ch - 'a')];
  }

  return oled_font6x8[0];
}

static OLED_Result OLED_WriteBytes(OLED_Handle *oled, uint8_t control, const uint8_t *data, uint16_t size)
{
  uint8_t tx_buffer[17];
  uint16_t offset = 0;
  uint16_t chunk_size;

  if ((oled == NULL) || (oled->hi2c == NULL) || (data == NULL))
  {
    return OLED_INVALID_PARAM;
  }

  while (offset < size)
  {
    chunk_size = size - offset;
    if (chunk_size > (sizeof(tx_buffer) - 1U))
    {
      chunk_size = sizeof(tx_buffer) - 1U;
    }

    tx_buffer[0] = control;
    memcpy(&tx_buffer[1], &data[offset], chunk_size);

    if (HAL_I2C_Master_Transmit(oled->hi2c,
                                (uint16_t)(oled->address << 1),
                                tx_buffer,
                                (uint16_t)(chunk_size + 1U),
                                HAL_MAX_DELAY) != HAL_OK)
    {
      return OLED_ERROR;
    }

    offset += chunk_size;
  }

  return OLED_OK;
}

OLED_Result OLED_Attach(OLED_Handle *oled, I2C_HandleTypeDef *hi2c, uint8_t address)
{
  if ((oled == NULL) || (hi2c == NULL))
  {
    return OLED_INVALID_PARAM;
  }

  oled->hi2c = hi2c;
  oled->address = address;
  oled->width = OLED_WIDTH;
  oled->height = OLED_HEIGHT;
  oled->page_count = OLED_PAGE_COUNT;

  return OLED_OK;
}

OLED_Result OLED_Init(OLED_Handle *oled)
{
  static const uint8_t init_cmds[] =
  {
    0xAE,
    0xD5, 0x80,
    0xA8, 0x3F,
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    0xA6,
    0xAF
  };
  uint32_t i;

  if ((oled == NULL) || (oled->hi2c == NULL))
  {
    return OLED_INVALID_PARAM;
  }

  HAL_Delay(100);

  for (i = 0; i < (sizeof(init_cmds) / sizeof(init_cmds[0])); i++)
  {
    if (OLED_WriteCommand(oled, init_cmds[i]) != OLED_OK)
    {
      return OLED_ERROR;
    }
  }

  return OLED_Clear(oled);
}

OLED_Result OLED_WriteCommand(OLED_Handle *oled, uint8_t cmd)
{
  return OLED_WriteBytes(oled, 0x00, &cmd, 1);
}

OLED_Result OLED_WriteData(OLED_Handle *oled, const uint8_t *data, uint16_t size)
{
  return OLED_WriteBytes(oled, 0x40, data, size);
}

OLED_Result OLED_SetCursor(OLED_Handle *oled, uint8_t page, uint8_t column)
{
  if ((oled == NULL) || (page >= oled->page_count) || (column >= oled->width))
  {
    return OLED_INVALID_PARAM;
  }

  if (OLED_WriteCommand(oled, (uint8_t)(0xB0U + page)) != OLED_OK)
  {
    return OLED_ERROR;
  }

  if (OLED_WriteCommand(oled, (uint8_t)(column & 0x0FU)) != OLED_OK)
  {
    return OLED_ERROR;
  }

  if (OLED_WriteCommand(oled, (uint8_t)(0x10U | (column >> 4))) != OLED_OK)
  {
    return OLED_ERROR;
  }

  return OLED_OK;
}

OLED_Result OLED_Fill(OLED_Handle *oled, uint8_t data)
{
  uint8_t page;
  uint8_t line_buffer[OLED_WIDTH];

  if (oled == NULL)
  {
    return OLED_INVALID_PARAM;
  }

  memset(line_buffer, data, sizeof(line_buffer));

  for (page = 0; page < oled->page_count; page++)
  {
    if (OLED_SetCursor(oled, page, 0) != OLED_OK)
    {
      return OLED_ERROR;
    }

    if (OLED_WriteData(oled, line_buffer, sizeof(line_buffer)) != OLED_OK)
    {
      return OLED_ERROR;
    }
  }

  return OLED_OK;
}

OLED_Result OLED_Clear(OLED_Handle *oled)
{
  return OLED_Fill(oled, 0x00);
}

OLED_Result OLED_ShowChar6x8(OLED_Handle *oled, uint8_t page, uint8_t column, char ch)
{
  const uint8_t *font;

  if ((oled == NULL) || (column > (oled->width - 6U)))
  {
    return OLED_INVALID_PARAM;
  }

  font = OLED_GetFont6x8(ch);

  if (OLED_SetCursor(oled, page, column) != OLED_OK)
  {
    return OLED_ERROR;
  }

  return OLED_WriteData(oled, font, 6);
}

OLED_Result OLED_ShowString6x8(OLED_Handle *oled, uint8_t page, uint8_t column, const char *str)
{
  if ((oled == NULL) || (str == NULL))
  {
    return OLED_INVALID_PARAM;
  }

  while (*str != '\0')
  {
    if (column > (oled->width - 6U))
    {
      page++;
      column = 0;
    }

    if (page >= oled->page_count)
    {
      return OLED_ERROR;
    }

    if (OLED_ShowChar6x8(oled, page, column, *str) != OLED_OK)
    {
      return OLED_ERROR;
    }

    column += 6U;
    str++;
  }

  return OLED_OK;
}

OLED_Result OLED_DisplayOn(OLED_Handle *oled)
{
  return OLED_WriteCommand(oled, 0xAF);
}

OLED_Result OLED_DisplayOff(OLED_Handle *oled)
{
  return OLED_WriteCommand(oled, 0xAE);
}
